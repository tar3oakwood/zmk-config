## boards/shields/gravity36_xiao/Kconfig.defconfig
```kconfig
if SHIELD_GRAVITY36_XIAO_LEFT || SHIELD_GRAVITY36_XIAO_RIGHT

config ZMK_KEYBOARD_NAME
    default "Gravity36"

config ZMK_SPLIT
    default y

config ZMK_SPLIT_BLE
    default y

config ZMK_POINTING
    default y

config ZMK_STUDIO
    default y if !ZMK_SETTINGS_RESET

config ZMK_BATTERY_REPORTING
    default y

config BT_MAX_CONN
    default 4

config BT_MAX_PAIRED
    default 4

endif

if SHIELD_GRAVITY36_XIAO_LEFT

config ZMK_USB
    default y

config ZMK_SPLIT_ROLE_CENTRAL
    default y

endif


if SHIELD_GRAVITY36_XIAO_RIGHT

endif
```

## boards/shields/gravity36_xiao/Kconfig.shield
```kconfig
config SHIELD_GRAVITY36_XIAO_LEFT
    def_bool $(shields_list_contains,gravity36_xiao_left)
config SHIELD_GRAVITY36_XIAO_RIGHT
    def_bool $(shields_list_contains,gravity36_xiao_right)
```

## config/boards/shields/gravity36_xiao_left/Kconfig.shield
```kconfig
config SHIELD_GRAVITY36_XIAO_LEFT
    def_bool $(shields_list_contains,gravity36_xiao_left)
```

## config/boards/shields/gravity36_xiao_right/Kconfig.defconfig
```kconfig
if SHIELD_GRAVITY36_XIAO_RIGHT
config ZMK_SPLIT
    default y
config ZMK_SPLIT_ROLE_CENTRAL
    default y
endif
```

## config/boards/shields/gravity36_xiao_right/Kconfig.shield
```kconfig
config SHIELD_GRAVITY36_XIAO_RIGHT
    def_bool $(shields_list_contains,gravity36_xiao_right)
```

## config/west.yml
```yaml
manifest:
  remotes:
    - name: zmkfirmware
      url-base: https://github.com
    - name: caksoylar
      url-base: https://github.com
  projects:
    - name: zmk
      remote: zmkfirmware
      revision: main
      import: app/west.yml
    - name: zmk-rgbled-widget
      remote: caksoylar
      revision: main
  self:
    path: config
```
