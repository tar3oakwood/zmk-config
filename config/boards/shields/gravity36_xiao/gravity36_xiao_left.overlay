#include "gravity36_xiao.dtsi"

&default_transform {
    map = <
        RC(0,0) RC(0,1) RC(0,2) RC(0,3) RC(0,4)
        RC(1,0) RC(1,1) RC(1,2) RC(1,3) RC(1,4)
        RC(2,0) RC(2,1) RC(2,2) RC(2,3) RC(2,4)
        RC(3,0) RC(3,1) RC(3,2)
    >;
};
