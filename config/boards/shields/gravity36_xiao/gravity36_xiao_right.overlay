#include "gravity36_xiao.dtsi"

&default_transform {
    map = <
        RC(4,0) RC(4,1) RC(4,2) RC(4,3) RC(4,4)
        RC(5,0) RC(5,1) RC(5,2) RC(5,3) RC(5,4)
        RC(6,0) RC(6,1) RC(6,2) RC(6,3) RC(6,4)
        RC(7,0) RC(7,1) RC(7,2)
    >;
};
