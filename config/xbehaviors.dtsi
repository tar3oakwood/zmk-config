/ {
    behaviors {
        xlt: lt_repeat_bs {
            compatible = "zmk,behavior-hold-tap";
            #binding-cells = <2>;
            tapping-term-ms = <200>;
            quick-tap-ms = <200>; // これで連続入力が可能に
            flavor = "tap-preferred";
            bindings = <&mo>, <&kp>;
        };
        xmt: my_hold_tap {
            compatible = "zmk,behavior-hold-tap";
            #binding-cells = <2>;
            tapping-term-ms = <200>;
            quick-tap-ms = <200>;
            flavor = "tap-preferred";
            bindings = <&kp>, <&kp>;
        };

    };
};

// キーマップでの使用例
// &xmt RSHFT SEMICOLON
// &xmt LCTRL ESC
// &xlt 1 BSPC
